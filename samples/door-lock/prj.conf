## CMakeLists.txt
```
# SPDX-License-Identifier: Apache-2.0

cmake_minimum_required(VERSION 3.20.0)

# tinytalk's door-lock on tinyble. Set TINYTALK=<a tinytalk tree> in the
# environment (sysbuild does not pass -DTINYTALK on to this image).
if(NOT TINYTALK)
  set(TINYTALK $ENV{TINYTALK})
endif()
if(NOT TINYTALK)
  message(FATAL_ERROR "set TINYTALK=<a tinytalk tree>")
endif()
list(APPEND ZEPHYR_EXTRA_MODULES ${CMAKE_CURRENT_SOURCE_DIR}/../.. ${TINYTALK})
find_package(Zephyr REQUIRED HINTS $ENV{ZEPHYR_BASE})
project(tinyble_door_lock)

target_sources(app PRIVATE src/main.c)

# The manual pairing code, for the boot log. tinytalk's script also stops the
# build when the verifier in .config does not match the passcode.
execute_process(
  COMMAND ${PYTHON_EXECUTABLE} ${TINYTALK}/scripts/spake2p_verifier.py --from-config ${DOTCONFIG}
  OUTPUT_VARIABLE TB_PAIRING_OUT
  ERROR_VARIABLE TB_PAIRING_ERR
  RESULT_VARIABLE TB_PAIRING_RC)
string(REGEX MATCH "setup code  ([0-9]+-[0-9]+-[0-9]+)" TB_PAIRING_MATCH "${TB_PAIRING_OUT}")
if(NOT TB_PAIRING_RC EQUAL 0 OR NOT CMAKE_MATCH_1)
  message(FATAL_ERROR "${TB_PAIRING_OUT}${TB_PAIRING_ERR}")
endif()
message(STATUS "manual pairing code: ${CMAKE_MATCH_1}")
target_compile_definitions(app PRIVATE MANUAL_CODE="${CMAKE_MATCH_1}")
```

## prj.conf
```kconfig
# tinytalk's door-lock (samples/door-lock/prj.conf) with BLE on tinyble. The
# tinytalk, crypto, Thread and logging sections are tinytalk's values; its
# comments there give the measurements behind them.

# ---- tinytalk -----------------------------------------------------------------
CONFIG_TINYTALK=y
CONFIG_TINYTALK_BLE=n
CONFIG_TINYTALK_THREAD=y
CONFIG_TINYTALK_DOOR_LOCK=y
CONFIG_GPIO=y
CONFIG_REBOOT=y
CONFIG_FLASH=y
CONFIG_FLASH_MAP=y
CONFIG_NVS=y
CONFIG_SETTINGS=y
CONFIG_SETTINGS_NVS=y
CONFIG_PM_PARTITION_SIZE_SETTINGS_STORAGE=0x4000
CONFIG_LIS2DH=n
CONFIG_I2C=n
CONFIG_SIZE_OPTIMIZATIONS=y
# Both lines, or LTO silently drops out of .config.
CONFIG_LTO=y
CONFIG_ISR_TABLES_LOCAL_DECLARATION=y
CONFIG_HEAP_MEM_POOL_SIZE=4096
CONFIG_MAIN_STACK_SIZE=4096
# PASE runs here, and now tinyble too.
CONFIG_SYSTEM_WORKQUEUE_STACK_SIZE=6144

# ---- BLE: tinyble on raw HCI to the SDC ------------------------------------------
CONFIG_BT=y
CONFIG_BT_HCI_RAW=y
CONFIG_TINYBLE=y
CONFIG_TINYBLE_TINYTALK=y
CONFIG_BT_MAX_CONN=1
CONFIG_BT_PERIPHERAL=y
CONFIG_BT_CENTRAL=n
CONFIG_BT_OBSERVER=n
CONFIG_BT_BROADCASTER=y
CONFIG_BT_EXT_ADV=n
CONFIG_BT_LL_SOFTDEVICE_PERIPHERAL=y
CONFIG_BT_CTLR_PHY_CODED=n
CONFIG_BT_CTLR_PHY_2M=n
CONFIG_BT_CTLR_LE_PING=n
# Raw HCI leaves these on; Zephyr's host turns them off for tinytalk's build,
# which paired with Apple Home without them.
CONFIG_BT_PHY_UPDATE=n
CONFIG_BT_CTLR_PRIVACY=n
CONFIG_BT_CTLR_FILTER_ACCEPT_LIST=n
CONFIG_BT_CTLR_CONN_RSSI=n
CONFIG_BT_HCI_VS=n
# tinyble never turns on controller-to-host flow control.
CONFIG_BT_HCI_ACL_FLOW_CONTROL=n
CONFIG_BT_HCI_DRIVER_LOG_LEVEL_WRN=y
# 27 B ACL packets, as in tinytalk's build: tinyble reassembles and splits
# L2CAP PDUs, so the controller needs no data length update.
CONFIG_BT_DATA_LEN_UPDATE=n
# M2's pools, not yet proven with an iPhone.
CONFIG_BT_BUF_EVT_RX_COUNT=2
CONFIG_BT_BUF_ACL_TX_COUNT=1

# ---- crypto: PSA on nrf_oberon ---------------------------------------------------
CONFIG_NRF_SECURITY=y
CONFIG_MBEDTLS_PSA_CRYPTO_C=y
CONFIG_MBEDTLS_ENABLE_HEAP=y
CONFIG_MBEDTLS_HEAP_SIZE=1024
CONFIG_PSA_WANT_ALG_ECDSA=y
CONFIG_PSA_WANT_ALG_ECDH=y
CONFIG_PSA_WANT_KEY_TYPE_ECC_KEY_PAIR_GENERATE=y
CONFIG_PSA_WANT_KEY_TYPE_ECC_KEY_PAIR_IMPORT=y
CONFIG_PSA_WANT_KEY_TYPE_ECC_KEY_PAIR_EXPORT=y
CONFIG_PSA_WANT_KEY_TYPE_ECC_KEY_PAIR_DERIVE=y
CONFIG_PSA_WANT_KEY_TYPE_ECC_PUBLIC_KEY=y
CONFIG_PSA_WANT_ECC_SECP_R1_256=y
CONFIG_PSA_WANT_ALG_SHA_256=y
CONFIG_PSA_WANT_ALG_ECB_NO_PADDING=y
CONFIG_PSA_WANT_KEY_TYPE_AES=y
CONFIG_PSA_WANT_GENERATE_RANDOM=y

# ---- Thread: an OpenThread MTD ------------------------------------------------------
CONFIG_OPENTHREAD=y
CONFIG_OPENTHREAD_MTD=y
CONFIG_OPENTHREAD_SRP_CLIENT=y
CONFIG_OPENTHREAD_SLAAC=y
CONFIG_OPENTHREAD_MANUAL_START=y
CONFIG_OPENTHREAD_THREAD_STACK_SIZE=4096
CONFIG_OPENTHREAD_PING_SENDER=n
CONFIG_OPENTHREAD_UPTIME=n
CONFIG_OPENTHREAD_THREAD_VERSION_1_1=y

# ---- logging: RTT ----------------------------------------------------------------------
CONFIG_UART_CONSOLE=n
CONFIG_LOG=y
CONFIG_LOG_MODE_MINIMAL=y
CONFIG_LOG_DEFAULT_LEVEL=3
CONFIG_USE_SEGGER_RTT=y
CONFIG_RTT_CONSOLE=y
CONFIG_SEGGER_RTT_BUFFER_SIZE_UP=8192
```

## src/main.c
```c
/* SPDX-License-Identifier: Apache-2.0 */

/*
 * tinytalk's door-lock sample on tinyble: the same node, boot order, LED and
 * button as tinytalk's samples/door-lock, with BLE on tinyble
 * (matter_ble_tinyble.c) instead of Zephyr's host.
 *
 * LED0 is on while unlocked. Button 0: a short press opens a commissioning
 * window for WINDOW_S; held for FACTORY_RESET_MS it erases the fabrics,
 * retracts the SRP records and reboots.
 */
#include <zephyr/drivers/gpio.h>
#include <zephyr/fs/nvs.h>
#include <zephyr/kernel.h>
#include <zephyr/logging/log.h>
#include <zephyr/settings/settings.h>
#include <zephyr/sys/reboot.h>

#include <psa/crypto.h>

#include <tinyble/tb_tinytalk.h>
#include <tinytalk/matter_commission.h>
#include <tinytalk/matter_fab_store.h>
#include <tinytalk/matter_thread.h>
#include <tinytalk/tm_door_lock.h>

LOG_MODULE_REGISTER(door_lock, LOG_LEVEL_INF);

#define WINDOW_S         900u
#define FACTORY_RESET_MS 5000
#define SRP_RETRACT_MS   2000

static const struct matter_commission_config s_matter_cfg = {
	.vendor_id = CONFIG_TINYTALK_VENDOR_ID,
	.product_id = CONFIG_TINYTALK_PRODUCT_ID,
	.verifier_hex = CONFIG_TINYTALK_SPAKE2P_VERIFIER,
	.salt_hex = CONFIG_TINYTALK_SPAKE2P_SALT,
	.iterations = CONFIG_TINYTALK_SPAKE2P_ITERATIONS,
	.product_name = "tinytalk door lock",
	.hardware_version = 1u,
	.software_version = 1u,
	.endpoints = &tm_door_lock_endpoint,
	.n_endpoints = 1u,
};

static const struct gpio_dt_spec s_led = GPIO_DT_SPEC_GET(DT_ALIAS(led0), gpios);
static const struct gpio_dt_spec s_button = GPIO_DT_SPEC_GET(DT_ALIAS(sw0), gpios);

/* The node asks with its lock held, so the work runs on the system queue. */
static void adv_work_fn(struct k_work *work)
{
	ARG_UNUSED(work);
	matter_ble_advertise(!matter_commission_has_fabric() || matter_commission_window_open());
}
static K_WORK_DEFINE(s_adv_work, adv_work_fn);

void matter_commission_readvertise(void)
{
	k_work_submit(&s_adv_work);
}

void tm_door_lock_actuate(uint8_t lock_state)
{
	(void)gpio_pin_set_dt(&s_led, lock_state == MATTER_DL_LOCK_STATE_UNLOCKED);
	LOG_INF("door %s", lock_state == MATTER_DL_LOCK_STATE_UNLOCKED ? "unlocked" : "locked");
}

/* ---- the button ------------------------------------------------------------ */

static struct gpio_callback s_button_cb;
/* -1 until a press this boot: the release after a factory-reset reboot is not
 * a short press. */
static int64_t s_pressed_at = -1;

/* Clearing the settings store also takes OpenThread's dataset and PSA's keys. */
static void reboot_fn(struct k_work *work)
{
	void *storage;

	ARG_UNUSED(work);
	if (settings_storage_get(&storage) == 0) {
		(void)nvs_clear(storage);
	}
	sys_reboot(SYS_REBOOT_COLD);
}
static K_WORK_DELAYABLE_DEFINE(s_reboot_work, reboot_fn);

/* Retract the SRP records first, or Apple Home dials the stale ones. */
static void factory_reset_fn(struct k_work *work)
{
	ARG_UNUSED(work);
	if (gpio_pin_get_dt(&s_button) != 1) {
		return;
	}
	LOG_WRN("button held: factory reset");
	(void)gpio_pin_set_dt(&s_led, 1);
	(void)matter_fab_erase();
	matter_thread_advertise_reset();
	(void)k_work_reschedule(&s_reboot_work, K_MSEC(SRP_RETRACT_MS));
}
static K_WORK_DELAYABLE_DEFINE(s_factory_reset_work, factory_reset_fn);

static void open_window_fn(struct k_work *work)
{
	ARG_UNUSED(work);
	if (matter_commission_open_window(WINDOW_S) == 0) {
		LOG_INF("commissioning window open for %u s", WINDOW_S);
	}
}
static K_WORK_DEFINE(s_open_window_work, open_window_fn);

static void on_button(const struct device *dev, struct gpio_callback *cb, uint32_t pins)
{
	ARG_UNUSED(dev);
	ARG_UNUSED(cb);
	ARG_UNUSED(pins);
	if (gpio_pin_get_dt(&s_button) == 1) {
		s_pressed_at = k_uptime_get();
		(void)k_work_reschedule(&s_factory_reset_work, K_MSEC(FACTORY_RESET_MS));
		return;
	}
	(void)k_work_cancel_delayable(&s_factory_reset_work);
	if (s_pressed_at >= 0 && k_uptime_get() - s_pressed_at < FACTORY_RESET_MS) {
		k_work_submit(&s_open_window_work);
	}
	s_pressed_at = -1;
}

static int button_init(void)
{
	int rc = gpio_is_ready_dt(&s_button) ? 0 : -ENODEV;

	if (rc == 0) {
		rc = gpio_pin_configure_dt(&s_button, GPIO_INPUT);
	}
	if (rc == 0) {
		rc = gpio_pin_interrupt_configure_dt(&s_button, GPIO_INT_EDGE_BOTH);
	}
	if (rc == 0) {
		gpio_init_callback(&s_button_cb, on_button, BIT(s_button.pin));
		rc = gpio_add_callback(s_button.port, &s_button_cb);
	}
	return rc;
}

int main(void)
{
	int rc;

	if (gpio_is_ready_dt(&s_led)) {
		(void)gpio_pin_configure_dt(&s_led, GPIO_OUTPUT_INACTIVE);
	}
	if (button_init() != 0) {
		LOG_WRN("no button: commissioning window and factory reset unavailable");
	}
	if (psa_crypto_init() != PSA_SUCCESS) {
		LOG_ERR("PSA Crypto did not start");
		return 0;
	}
	rc = settings_subsys_init();
	if (rc != 0) {
		LOG_ERR("settings did not start (%d)", rc);
		return 0;
	}
	rc = matter_ble_start();
	if (rc != 0) {
		LOG_ERR("Bluetooth did not start (%d)", rc);
		return 0;
	}
	rc = matter_commission_init(&s_matter_cfg);
	if (rc != 0) {
		LOG_ERR("Matter node did not start (%d)", rc);
		return 0;
	}
	LOG_INF("manual pairing code %s, discriminator 0x%03x", MANUAL_CODE,
		CONFIG_TINYTALK_DISCRIMINATOR);
	matter_commission_readvertise();
	return 0;
}
```
