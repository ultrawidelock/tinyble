## zephyr/Kconfig
```kconfig
# SPDX-License-Identifier: Apache-2.0

config TINYBLE
	bool "tinyble: minimal BLE peripheral host over raw HCI"
	depends on BT_HCI_RAW

config TINYBLE_MATTER_GATT
	bool "Matter commissioning GATT table"
	depends on TINYBLE
	default y

config TINYBLE_TINYFOTA
	bool "tinyfota's DFU services in the Matter table"
	depends on TINYBLE_MATTER_GATT
	help
	  SMP and tinyfota's native DFU service after the Matter services, at
	  the handles in include/tinyble/tb_dfu.h, Find By Type Value, which
	  clients send to find a service by its UUID, and tb_service_changed(),
	  for the transport to call on the first boot after an update so that
	  clients holding the old table learn of the new handles. With
	  TINYBLE_TINYTALK the adapter hands their writes, their CCC writes
	  and every disconnect to tb_dfu_on_write(), tb_dfu_on_ccc() and
	  tb_dfu_on_disconnect(), which the DFU transport provides.

config TINYBLE_TINYTALK
	bool "tinytalk's BLE transport (matter_ble.h) on tinyble"
	depends on TINYBLE_MATTER_GATT && TINYTALK && !TINYTALK_BLE
	select TINYTALK_HAS_BLE
	select POLL

config TINYBLE_TINYTALK_SCAN_RSP_UUID128
	string "128-bit service UUID for the scan response"
	depends on TINYBLE_TINYTALK
	default ""
	help
	  Sent in the scan response whenever the adapter advertises, as one
	  Complete List of 128-bit Service UUIDs (AD type 0x07, 18 B): for
	  example 8d53dc1d-1db7-4cd3-868b-8a527460aa84, SMP's service, for
	  clients that look for it before connecting. Written as 32 hex
	  digits, hyphens allowed; anything else stops the build. Empty, the
	  default, sends no scan response and builds no code for one.

if TINYBLE_TINYTALK
module = TINYBLE_TINYTALK
module-str = tinyble tinytalk adapter (DBG: BTP seq, ack, indications)
source "subsys/logging/Kconfig.template.log_config"
endif
```
